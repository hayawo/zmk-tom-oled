/*
 * Copyright (c) 2024 The ZMK Contributors
 *
 * SPDX-License-Identifier: MIT
 */

/ {
    behaviors {
        oled_mode: oled_mode {
            compatible = "zmk,behavior-oled-mode";
            #binding-cells = <0>;
            display-name = "OLED Mode Toggle";
        };

        oled_power: oled_power {
            compatible = "zmk,behavior-oled-power";
            #binding-cells = <0>;
            display-name = "OLED On/Off";
        };
    };
};
