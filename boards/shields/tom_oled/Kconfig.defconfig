## boards/shields/tom_oled/Kconfig.defconfig
```kconfig
# Copyright (c) 2024 The ZMK Contributors
# SPDX-License-Identifier: MIT

if SHIELD_TOM_OLED

choice ZMK_DISPLAY_STATUS_SCREEN
    default ZMK_DISPLAY_STATUS_SCREEN_CUSTOM
endchoice

config ZMK_DISPLAY_STATUS_SCREEN_CUSTOM
    select LV_USE_LABEL
    select LV_USE_IMG
    select LV_USE_CANVAS
    select LV_USE_ANIMIMG
    select LV_USE_ANIMATION
    select LV_USE_LINE
    select LV_FONT_UNSCII_8
    select ZMK_WPM if (!ZMK_SPLIT || ZMK_SPLIT_ROLE_CENTRAL)
    select ZMK_SPLIT_RELAY_EVENT if ZMK_SPLIT
    imply ZMK_HID_INDICATORS

config ZMK_TOM_OLED_CODEX_STATUS
    bool "Start central OLED in agent status mode"
    default n
    depends on !ZMK_SPLIT || ZMK_SPLIT_ROLE_CENTRAL
    help
      Select the initial central OLED mode when there is no saved selection.
      y starts with the Codex/Claude Code status widget and n starts with Bongo
      Cat. The oled_mode key behavior can switch either mode at runtime.

config ZMK_TOM_OLED_CODEX_STATUS_STUDIO_RPC
    bool "Receive Codex status through ZMK Studio custom RPC"
    default y
    depends on ZMK_STUDIO_RPC
    help
      Register the tom_oled__codex_status custom subsystem. BLE transport is
      enabled by ZMK Studio by default when ZMK BLE support is available.

config ZMK_TOM_OLED_CODEX_STATUS_DEFAULT_TTL_SEC
    int "Default Codex status timeout in seconds"
    default 120
    range 1 3600
    depends on ZMK_TOM_OLED_CODEX_STATUS_STUDIO_RPC

config ZMK_TOM_OLED_CODEX_STATUS_MAX_TTL_SEC
    int "Maximum Codex status timeout in seconds"
    default 3600
    range 1 65535
    depends on ZMK_TOM_OLED_CODEX_STATUS_STUDIO_RPC

config ZMK_TOM_OLED_DONGLE_BATTERY
    bool "Show also the battery level of the dongle"
    depends on BT && (!ZMK_SPLIT_BLE || ZMK_SPLIT_ROLE_CENTRAL)

config ZMK_SPLIT_BLE_CENTRAL_BATTERY_LEVEL_FETCHING
    default y if ZMK_SPLIT_BLE && ZMK_SPLIT_ROLE_CENTRAL

config ZMK_TOM_OLED_MAC_MODIFIERS
    bool "Use MacOS modifier symbols instead of the Windows symbols"

config ZMK_TOM_OLED_POWER_CONTROL
    bool "Allow turning the OLEDs off with the oled_power key behavior"
    default y
    help
      Adds the &oled_power behavior, which turns both halves' OLEDs off and
      keeps them off until pressed again. The choice is stored in settings and
      relayed to the peripheral. The OLED is the single largest consumer on a
      battery powered build, so this is the main power saving lever.

      This makes tom_oled own display blanking instead of ZMK core: idle
      blanking is handled in widgets/oled_power.c so that the two do not fight
      over the panel on every activity transition.

# oled_power.c がアイドル時のブランクも引き受けるため、本体側は無効にする。
# 両方が動くと、消灯中でも打鍵のたびに ZMK 本体がパネルを点け直してしまう。
config ZMK_DISPLAY_BLANK_ON_IDLE
    default n if ZMK_TOM_OLED_POWER_CONTROL

choice ZMK_DISPLAY_WORK_QUEUE
    default ZMK_DISPLAY_WORK_QUEUE_DEDICATED
endchoice

config LV_Z_MEM_POOL_SIZE
    default 8192

config LV_Z_VDB_SIZE
    default 64

config LV_DPI_DEF
    default 148

config LV_Z_BITS_PER_PIXEL
    default 1

choice LV_COLOR_DEPTH
    default LV_COLOR_DEPTH_1
endchoice

endif
```

## boards/shields/tom_oled_180/Kconfig.shield
```kconfig
# Copyright (c) 2026 The ZMK Contributors
#
# SPDX-License-Identifier: MIT

config SHIELD_TOM_OLED_180
    def_bool $(shields_list_contains,tom_oled_180)
```

## dts/bindings/behaviors/zmk,behavior-oled-mode.yaml
```yaml
# Copyright (c) 2026 The ZMK Contributors
# SPDX-License-Identifier: MIT

description: Toggle the central tom_oled between Bongo Cat and agent status

compatible: "zmk,behavior-oled-mode"

include: zero_param.yaml
```

## dts/bindings/behaviors/zmk,behavior-oled-power.yaml
```yaml
# Copyright (c) 2026 The ZMK Contributors
# SPDX-License-Identifier: MIT

description: Turn both OLEDs on or off to save battery

compatible: "zmk,behavior-oled-power"

include: zero_param.yaml
```
